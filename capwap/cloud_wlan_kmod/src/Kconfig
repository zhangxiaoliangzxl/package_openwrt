## capwap/cloud_wlan_kmod/src/Kconfig
```kconfig
config CAPWAP
	tristate "capwap for fit AP"
	default n
	help
	This is a example, for debugging kernel model.
	If unsure, say N.
```

## location/blue_v2/config.in
```kconfig
if PACKAGE_blue_v2

choice
prompt "blue_v2 config for tty"

default PACKAGE_blue_v2_only

config PACKAGE_blue_v2_only
	bool "blue_v2_only"

config PACKAGE_blue_v2_coexistence
	bool "blue_v2_coexistence"

endchoice
		
endif
```

## location/bluetooth2/config.in
```kconfig
if PACKAGE_bluetooth2

choice
prompt "bluetooth2 config for tty"

default PACKAGE_bluetooth2_only

config PACKAGE_bluetooth2_only
	bool "bluetooth2_only"

config PACKAGE_bluetooth2_coexistence
	bool "bluetooth2_coexistence"

endchoice
		
endif
```

## location/uwb_v2/config.in
```kconfig
if PACKAGE_uwb_v2

choice
prompt "uwb config for tty"

default PACKAGE_uwb_only

config PACKAGE_uwb_only
	bool "uwb_only"

config PACKAGE_uwb_coexistence
	bool "uwb_coexistence"

endchoice
		
endif
```

## netlink_notify/src/Kconfig
```kconfig
config NETLINK_NOTIFY
	tristate "This is a module for netlink_notify"
	default n
	---help---
	  This is a module for notify netlink status.

	  To compile this code as a module, choose M here: the module will be
	  called shortcut-fe.

	  If unsure, say N.
```
